FUNC_TABLE equ 64
SERIAL_WRITE equ FUNC_TABLE+0
BREAKPOINT equ FUNC_TABLE+3
I2C_BEGIN equ FUNC_TABLE+6
I2C_END equ FUNC_TABLE+9
I2C_TRANSFER equ FUNC_TABLE+12
I2C_RECEIVE equ FUNC_TABLE+15
I2C_ROM_READ_ABS equ FUNC_TABLE+18
I2C_ROM_READ_NEXT equ FUNC_TABLE+21
SPI_TRANSFER equ FUNC_TABLE+24
SPI_RECEIVE equ FUNC_TABLE+27
SPI_ROM_SELECT equ FUNC_TABLE+30
SPI_ROM_DESELECT equ FUNC_TABLE+33
SPI_ROM_READ_BEGIN equ FUNC_TABLE+36
PRINT_HEX equ FUNC_TABLE+39
SERIAL_READ equ FUNC_TABLE+42
PUTS equ FUNC_TABLE+45
MUL_8x8 equ FUNC_TABLE+48
MULE_8x8 equ FUNC_TABLE+51
MUL_16x16 equ FUNC_TABLE+54
DIV_8x8 equ FUNC_TABLE+57
DIV_16x16 equ FUNC_TABLE+60
ITOA16 equ FUNC_TABLE+63
PRINTINT16 equ FUNC_TABLE+66
MULE_16x16 equ FUNC_TABLE+69
MULE_32x32 equ FUNC_TABLE+72
DIV_32x32 equ FUNC_TABLE+75
DIV_48x32 equ FUNC_TABLE+78
ITOA32 equ FUNC_TABLE+81
PRINTINT32 equ FUNC_TABLE+84
MUL_8x8_SIGNED equ FUNC_TABLE+87
MULE_8x8_SIGNED equ FUNC_TABLE+90
MUL_16x16_SIGNED equ FUNC_TABLE+93
MULE_16x16_SIGNED equ FUNC_TABLE+96
MULE_32x32_SIGNED equ FUNC_TABLE+99
DIV_8x8_SIGNED equ FUNC_TABLE+102
DIV_16x16_SIGNED equ FUNC_TABLE+105
DIV_32x32_SIGNED equ FUNC_TABLE+108
DIV_48x32_SIGNED equ FUNC_TABLE+111
MUL_FIXED equ FUNC_TABLE+114
DIV_FIXED equ FUNC_TABLE+117
FITOA equ FUNC_TABLE+120
SQRT_FIXED equ FUNC_TABLE+123
XORSHIFT equ FUNC_TABLE+126

LMEM_START equ 32768

MIN00 equ LMEM_START+25
MIN01 equ LMEM_START+26
MIN02 equ LMEM_START+27
MIN03 equ LMEM_START+28
MIN10 equ LMEM_START+29
MIN11 equ LMEM_START+30
MIN12 equ LMEM_START+31
MIN13 equ LMEM_START+32
MRES0 equ LMEM_START+33
MRES1 equ LMEM_START+34
MRES2 equ LMEM_START+35
MRES3 equ LMEM_START+36
MRES4 equ LMEM_START+37
MRES5 equ LMEM_START+38
MRES6 equ LMEM_START+39
MRES7 equ LMEM_START+40
DIN00 equ LMEM_START+41
DIN01 equ LMEM_START+42
DIN02 equ LMEM_START+43
DIN03 equ LMEM_START+44
DIN04 equ LMEM_START+45
DIN05 equ LMEM_START+46
DIN10 equ LMEM_START+47
DIN11 equ LMEM_START+48
DIN12 equ LMEM_START+49
DIN13 equ LMEM_START+50
DRES0 equ LMEM_START+51
DRES1 equ LMEM_START+52
DRES2 equ LMEM_START+53
DRES3 equ LMEM_START+54
DRES4 equ LMEM_START+55
DRES5 equ LMEM_START+56
REM0 equ LMEM_START+57
REM1 equ LMEM_START+58
REM2 equ LMEM_START+59
REM3 equ LMEM_START+60
FOUT0 equ LMEM_START+61
FOUT1 equ LMEM_START+62
FOUT2 equ LMEM_START+63
FOUT3 equ LMEM_START+64
XS_STATE0 equ LMEM_START+65

MEM_START equ 55000

	org 33024
start:
	jmp actual_start
int_handler:
	push h
	push d
	push b
	mvi a, 'a'
	call SERIAL_WRITE
	pop b
	pop d
	pop h
	ret
actual_start:
	mvi a, 11001011b
	sim
	call delay
	mvi a, 01000000b
	sim
	call delay
	jmp actual_start
delay:
	mvi l, 64
delay_loop:
	mvi a, 0
delay_loop_inner:
	adi 1
	nop
	nop
	nop
	nop
	nop
	nop
	nop
	nop
	nop
	jnc delay_loop_inner
	dcr l
	jnz delay_loop
	ret
